## br_external/Config.in
```kconfig
menu "Linux Build System Options"

config BR2_PACKAGE_LINUX_BUILD
	bool "Linux multi-arch build system"
	help
	  Linux Build System is a Buildroot external tree for building Linux
	  systems across multiple architectures and kernel versions.

endmenu
```

## br_external/configs/linux3_arm_vexpress_defconfig
```kconfig
# Architecture: ARM 32-bit (Cortex-A9)
BR2_arm=y
BR2_cortex_a9=y
BR2_ARM_ENABLE_NEON=y
BR2_ARM_ENABLE_VFP=y

# Toolchain: Buildroot internal with glibc
BR2_TOOLCHAIN_BUILDROOT=y
BR2_TOOLCHAIN_BUILDROOT_GLIBC=y

# Kernel headers: manually set to 3.16.x to match our kernel
BR2_KERNEL_HEADERS_VERSION=y
BR2_DEFAULT_KERNEL_VERSION="3.16.85"
BR2_PACKAGE_HOST_LINUX_HEADERS_CUSTOM_3_16=y

# Global patch directory for kernel patches
BR2_GLOBAL_PATCH_DIR="$(BR2_EXTERNAL_LINUX_BUILD_PATH)/patches"

# System configuration
BR2_TARGET_GENERIC_ROOT_PASSWD=""
BR2_TARGET_GENERIC_GETTY_PORT="ttyAMA0"
BR2_ROOTFS_DEVICE_CREATION_DYNAMIC_EUDEV=y

# Linux kernel: custom version 3.16.x
BR2_LINUX_KERNEL=y
BR2_LINUX_KERNEL_CUSTOM_VERSION=y
BR2_LINUX_KERNEL_CUSTOM_VERSION_VALUE="3.16.85"
BR2_LINUX_KERNEL_DEFCONFIG="vexpress"
BR2_LINUX_KERNEL_CONFIG_FRAGMENT_FILES="$(BR2_EXTERNAL_LINUX_BUILD_PATH)/board/arm/vexpress/kernel-fragment.config"
BR2_LINUX_KERNEL_DTS_SUPPORT=y
BR2_LINUX_KERNEL_INTREE_DTS_NAME="vexpress-v2p-ca9"
BR2_LINUX_KERNEL_NEEDS_HOST_OPENSSL=y
BR2_LINUX_KERNEL_INSTALL_TARGET=y

# Root filesystem: ext4, SD card image
BR2_TARGET_ROOTFS_EXT2=y
BR2_TARGET_ROOTFS_EXT2_4=y
BR2_TARGET_ROOTFS_EXT2_SIZE="120M"
# BR2_TARGET_ROOTFS_TAR is not set

# Use genimage for SD card image
BR2_PACKAGE_HOST_GENIMAGE=y
BR2_PACKAGE_HOST_DOSFSTOOLS=y
BR2_PACKAGE_HOST_MTOOLS=y

# Post-image script for genimage
BR2_ROOTFS_POST_IMAGE_SCRIPT="support/scripts/genimage.sh"
BR2_ROOTFS_POST_SCRIPT_ARGS="-c $(BR2_EXTERNAL_LINUX_BUILD_PATH)/board/arm/vexpress/genimage.cfg"

# Shared download cache and ccache
BR2_DL_DIR="$(TOPDIR)/../dl"
BR2_CCACHE=y
BR2_CCACHE_DIR="$(TOPDIR)/../.ccache"

# Minimal userspace
BR2_PACKAGE_DROPBEAR=y
BR2_PACKAGE_BUSYBOX=y
```

## br_external/configs/linux4_x86_64_defconfig
```kconfig
# Architecture: x86_64
BR2_x86_64=y

# Toolchain: use Buildroot internal toolchain with glibc
BR2_TOOLCHAIN_BUILDROOT=y
BR2_TOOLCHAIN_BUILDROOT_GLIBC=y

# Kernel headers: use same as kernel source (4.19.x)
BR2_KERNEL_HEADERS_AS_KERNEL=y
BR2_PACKAGE_HOST_LINUX_HEADERS_CUSTOM_4_19=y

# Global patch directory for kernel patches (arch-specific)
BR2_GLOBAL_PATCH_DIR="$(BR2_EXTERNAL_LINUX_BUILD_PATH)/patches"

# System configuration
BR2_TARGET_GENERIC_GETTY_PORT="ttyS0"
BR2_ROOTFS_DEVICE_CREATION_DYNAMIC_EUDEV=y

# Linux kernel: custom version 4.19.x
BR2_LINUX_KERNEL=y
BR2_LINUX_KERNEL_CUSTOM_VERSION=y
BR2_LINUX_KERNEL_CUSTOM_VERSION_VALUE="4.19.325"
BR2_LINUX_KERNEL_USE_ARCH_DEFAULT_CONFIG=y
BR2_LINUX_KERNEL_CONFIG_FRAGMENT_FILES="$(BR2_EXTERNAL_LINUX_BUILD_PATH)/board/x86_64/kernel-fragment.config"
BR2_LINUX_KERNEL_INSTALL_TARGET=y
BR2_LINUX_KERNEL_NEEDS_HOST_OPENSSL=y

# Root filesystem: ext4
BR2_TARGET_ROOTFS_EXT2=y
BR2_TARGET_ROOTFS_EXT2_4=y
BR2_TARGET_ROOTFS_EXT2_SIZE="120M"
# BR2_TARGET_ROOTFS_TAR is not set

# Bootloader: GRUB2 BIOS
BR2_TARGET_GRUB2=y
BR2_TARGET_GRUB2_INSTALL_TOOLS=y

# Shared download cache and ccache
BR2_DL_DIR="$(TOPDIR)/../dl"
BR2_CCACHE=y
BR2_CCACHE_DIR="$(TOPDIR)/../.ccache"

# Host utilities
BR2_PACKAGE_HOST_GENIMAGE=y
BR2_PACKAGE_HOST_DOSFSTOOLS=y
BR2_PACKAGE_HOST_MTOOLS=y

# Post-build / post-image scripts
BR2_ROOTFS_POST_BUILD_SCRIPT="$(BR2_EXTERNAL_LINUX_BUILD_PATH)/board/x86_64/post-build.sh"
BR2_ROOTFS_POST_IMAGE_SCRIPT="support/scripts/genimage.sh"
BR2_ROOTFS_POST_SCRIPT_ARGS="-c $(BR2_EXTERNAL_LINUX_BUILD_PATH)/board/x86_64/genimage-bios.cfg"

# Minimal userspace packages
BR2_PACKAGE_BUSYBOX=y
BR2_PACKAGE_ACPID=y
BR2_PACKAGE_CONNMAN=y
BR2_PACKAGE_CONNMAN_CLIENT=y
```

## br_external/configs/linux5_riscv64_virt_defconfig
```kconfig
# Architecture: RISC-V 64-bit
BR2_riscv=y
BR2_RISCV_64=y

# Toolchain: Buildroot internal with glibc
BR2_TOOLCHAIN_BUILDROOT=y
BR2_TOOLCHAIN_BUILDROOT_GLIBC=y

# Kernel headers: use same as kernel source (5.10.x)
BR2_KERNEL_HEADERS_AS_KERNEL=y
BR2_PACKAGE_HOST_LINUX_HEADERS_CUSTOM_5_10=y

# Global patch directory for kernel patches
BR2_GLOBAL_PATCH_DIR="$(BR2_EXTERNAL_LINUX_BUILD_PATH)/patches"

# System configuration
BR2_TARGET_GENERIC_ROOT_PASSWD=""
BR2_TARGET_GENERIC_GETTY_PORT="ttyS0"
BR2_ROOTFS_DEVICE_CREATION_DYNAMIC_EUDEV=y
BR2_SYSTEM_DHCP="eth0"

# Linux kernel: custom version 5.10.x
BR2_LINUX_KERNEL=y
BR2_LINUX_KERNEL_CUSTOM_VERSION=y
BR2_LINUX_KERNEL_CUSTOM_VERSION_VALUE="5.10.235"
BR2_LINUX_KERNEL_USE_ARCH_DEFAULT_CONFIG=y
BR2_LINUX_KERNEL_CONFIG_FRAGMENT_FILES="$(BR2_EXTERNAL_LINUX_BUILD_PATH)/board/riscv64/virt/kernel-fragment.config"
BR2_LINUX_KERNEL_NEEDS_HOST_OPENSSL=y

# OpenSBI (RISC-V firmware)
BR2_TARGET_OPENSBI=y
BR2_TARGET_OPENSBI_CUSTOM_VERSION=y
BR2_TARGET_OPENSBI_CUSTOM_VERSION_VALUE="1.6"
BR2_TARGET_OPENSBI_PLAT="generic"

# Root filesystem: ext4
BR2_TARGET_ROOTFS_EXT2=y
BR2_TARGET_ROOTFS_EXT2_4=y
BR2_TARGET_ROOTFS_EXT2_SIZE="120M"
# BR2_TARGET_ROOTFS_TAR is not set

# Post-image script for genimage
BR2_PACKAGE_HOST_GENIMAGE=y
BR2_ROOTFS_POST_BUILD_SCRIPT="$(BR2_EXTERNAL_LINUX_BUILD_PATH)/board/riscv64/virt/post-build.sh"
BR2_ROOTFS_POST_IMAGE_SCRIPT="support/scripts/genimage.sh"
BR2_ROOTFS_POST_SCRIPT_ARGS="-c $(BR2_EXTERNAL_LINUX_BUILD_PATH)/board/riscv64/virt/genimage.cfg"

# Shared download cache and ccache
BR2_DL_DIR="$(TOPDIR)/../dl"
BR2_CCACHE=y
BR2_CCACHE_DIR="$(TOPDIR)/../.ccache"

# Minimal userspace
BR2_PACKAGE_BUSYBOX=y

# SSH server: OpenSSH (with sftp-server built-in)
BR2_PACKAGE_OPENSSH=y
BR2_PACKAGE_OPENSSH_SERVER=y

# Development tools for kernel module / C / C++ / Rust development
BR2_PACKAGE_BASH=y
BR2_PACKAGE_NANO=y
BR2_PACKAGE_IPROUTE2=y
BR2_PACKAGE_PROCPS_NG=y
BR2_PACKAGE_STRACE=y
BR2_PACKAGE_LTRACE=y
BR2_PACKAGE_RSYNC=y
BR2_PACKAGE_WHICH=y
BR2_PACKAGE_LESS=y
BR2_PACKAGE_FINDUTILS=y
BR2_PACKAGE_DIFFUTILS=y
BR2_PACKAGE_PATCH=y
BR2_PACKAGE_E2FSPROGS=y
BR2_PACKAGE_LSOF=y
BR2_PACKAGE_FILE=y
BR2_PACKAGE_HTOP=y
BR2_PACKAGE_TREE=y
BR2_PACKAGE_GZIP=y
BR2_PACKAGE_BZIP2=y
BR2_PACKAGE_XZ=y
BR2_PACKAGE_ELFUTILS=y
# GDB server for remote debugging
BR2_PACKAGE_GDB=y
```

## br_external/configs/linux6_riscv64_virt_defconfig
```kconfig
# Architecture: RISC-V 64-bit
BR2_riscv=y
BR2_RISCV_64=y

# Toolchain: Buildroot internal with glibc
BR2_TOOLCHAIN_BUILDROOT=y
BR2_TOOLCHAIN_BUILDROOT_GLIBC=y

# Kernel headers: use same as kernel source (6.6.x)
BR2_KERNEL_HEADERS_AS_KERNEL=y
BR2_PACKAGE_HOST_LINUX_HEADERS_CUSTOM_6_6=y

# Global patch directory for kernel patches (organized by kernel version)
BR2_GLOBAL_PATCH_DIR="$(BR2_EXTERNAL_LINUX_BUILD_PATH)/patches"

# Shared download cache and ccache (TOPDIR = buildroot/, so ../ points to project root)
BR2_DL_DIR="$(TOPDIR)/../dl"
BR2_CCACHE=y
BR2_CCACHE_DIR="$(TOPDIR)/../.ccache"

# System configuration
BR2_TARGET_GENERIC_ROOT_PASSWD=""
BR2_TARGET_GENERIC_GETTY_PORT="ttyS0"
BR2_ROOTFS_DEVICE_CREATION_DYNAMIC_EUDEV=y
BR2_SYSTEM_DHCP="eth0"

# Linux kernel: custom version 6.6.x
BR2_LINUX_KERNEL=y
BR2_LINUX_KERNEL_CUSTOM_VERSION=y
BR2_LINUX_KERNEL_CUSTOM_VERSION_VALUE="6.6.99"
BR2_LINUX_KERNEL_USE_ARCH_DEFAULT_CONFIG=y
BR2_LINUX_KERNEL_CONFIG_FRAGMENT_FILES="$(BR2_EXTERNAL_LINUX_BUILD_PATH)/board/riscv64/virt/kernel-fragment.config"
BR2_LINUX_KERNEL_NEEDS_HOST_OPENSSL=y

# OpenSBI (RISC-V firmware)
BR2_TARGET_OPENSBI=y
BR2_TARGET_OPENSBI_CUSTOM_VERSION=y
BR2_TARGET_OPENSBI_CUSTOM_VERSION_VALUE="1.6"
BR2_TARGET_OPENSBI_PLAT="generic"

# Root filesystem: ext4
BR2_TARGET_ROOTFS_EXT2=y
BR2_TARGET_ROOTFS_EXT2_4=y
BR2_TARGET_ROOTFS_EXT2_SIZE="120M"
# BR2_TARGET_ROOTFS_TAR is not set

# Bootloader: none (OpenSBI + QEMU direct kernel boot)
# Post-image script for genimage
BR2_PACKAGE_HOST_GENIMAGE=y
BR2_ROOTFS_POST_IMAGE_SCRIPT="support/scripts/genimage.sh"
BR2_ROOTFS_POST_SCRIPT_ARGS="-c $(BR2_EXTERNAL_LINUX_BUILD_PATH)/board/riscv64/virt/genimage.cfg"

# Minimal userspace
BR2_PACKAGE_BUSYBOX=y
BR2_PACKAGE_OPENSSH=y
BR2_PACKAGE_OPENSSH_SERVER=y
```
